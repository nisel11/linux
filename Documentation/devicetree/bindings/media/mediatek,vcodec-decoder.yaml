## Documentation/devicetree/bindings/media/mediatek,vcodec-decoder.yaml
```yaml
# SPDX-License-Identifier: (GPL-2.0-only OR BSD-2-Clause)
%YAML 1.2
---
$id: http://devicetree.org/schemas/media/mediatek,vcodec-decoder.yaml#
$schema: http://devicetree.org/meta-schemas/core.yaml#

title: Mediatek Video Decode Accelerator

maintainers:
  - Yunfei Dong <yunfei.dong@mediatek.com>

description: |+
  Mediatek Video Decode is the video decode hardware present in Mediatek
  SoCs which supports high resolution decoding functionalities.

properties:
  compatible:
    enum:
      - mediatek,mt8173-vcodec-dec
      - mediatek,mt8183-vcodec-dec
      - mediatek,mt6768-vcodec-dec

  reg:
    minItems: 7
    maxItems: 11

  reg-names:
    minItems: 7
    maxItems: 11
    items:
      enum:
        - misc
        - ld
        - top
        - cm
        - ad
        - av
        - pp
        - hwd
        - hwq
        - hwb
        - hwg

  interrupts:
    maxItems: 1

  clocks:
    minItems: 1
    maxItems: 8

  clock-names:
    minItems: 1
    maxItems: 8

  assigned-clocks: true

  assigned-clock-parents: true

  assigned-clock-rates: true

  power-domains:
    maxItems: 1

  iommus:
    minItems: 1
    maxItems: 32
    description: |
      List of the hardware port in respective IOMMU block for current Socs.
      Refer to bindings/iommu/mediatek,iommu.yaml.

  mediatek,vpu:
    $ref: /schemas/types.yaml#/definitions/phandle
    description:
      Describes point to vpu.

  mediatek,scp:
    $ref: /schemas/types.yaml#/definitions/phandle
    description:
      Describes point to scp.

  mediatek,vdecsys:
    $ref: /schemas/types.yaml#/definitions/phandle
    description: Phandle to the vdecsys syscon node.

required:
  - compatible
  - reg
  - interrupts
  - clocks
  - clock-names
  - iommus
  - mediatek,vdecsys

allOf:
  - if:
      properties:
        compatible:
          contains:
            const: mediatek,mt6768-vcodec-dec
    then:
      required:
        - reg-names

      properties:
        reg:
          minItems: 7
          maxItems: 7

        reg-names:
          minItems: 7
          maxItems: 7
          items:
            - const: misc
            - const: ld
            - const: top
            - const: cm
            - const: ad
            - const: av
            - const: pp

        iommus:
          minItems: 9
          maxItems: 9

        clocks:
          minItems: 1
          maxItems: 1

        clock-names:
          minItems: 1
          maxItems: 1
          items:
            - const: vdec

  - if:
      properties:
        compatible:
          contains:
            enum:
              - mediatek,mt8183-vcodec-dec

    then:
      required:
        - mediatek,scp

      properties:
        reg:
          minItems: 11
          maxItems: 11

        reg-names:
          items:
            - const: misc
            - const: ld
            - const: top
            - const: cm
            - const: ad
            - const: av
            - const: pp
            - const: hwd
            - const: hwq
            - const: hwb
            - const: hwg

        clocks:
          minItems: 1
          maxItems: 1

        clock-names:
          items:
            - const: vdec

  - if:
      properties:
        compatible:
          contains:
            enum:
              - mediatek,mt8173-vcodec-dec

    then:
      required:
        - mediatek,vpu

      properties:
        reg:
          minItems: 11
          maxItems: 11

        reg-names:
          items:
            - const: misc
            - const: ld
            - const: top
            - const: cm
            - const: ad
            - const: av
            - const: pp
            - const: hwd
            - const: hwq
            - const: hwb
            - const: hwg

        clocks:
          minItems: 8
          maxItems: 8

        clock-names:
          items:
            - const: vcodecpll
            - const: univpll_d2
            - const: clk_cci400_sel
            - const: vdec_sel
            - const: vdecpll
            - const: vencpll
            - const: venc_lt_sel
            - const: vdec_bus_clk_src

additionalProperties: false

examples:
  - |
    #include <dt-bindings/interrupt-controller/arm-gic.h>
    #include <dt-bindings/clock/mt8173-clk.h>
    #include <dt-bindings/memory/mt8173-larb-port.h>
    #include <dt-bindings/interrupt-controller/irq.h>
    #include <dt-bindings/power/mt8173-power.h>

    vcodec_dec: vcodec@16020000 {
      compatible = "mediatek,mt8173-vcodec-dec";
      reg = <0x16020000 0x1000>,  /*VDEC_MISC*/
          <0x16021000 0x800>,   /*VDEC_LD*/
          <0x16021800 0x800>,   /*VDEC_TOP*/
          <0x16022000 0x1000>,  /*VDEC_CM*/
          <0x16023000 0x1000>,  /*VDEC_AD*/
          <0x16024000 0x1000>,  /*VDEC_AV*/
          <0x16025000 0x1000>,  /*VDEC_PP*/
          <0x16026800 0x800>,   /*VP8_VD*/
          <0x16027000 0x800>,   /*VP6_VD*/
          <0x16027800 0x800>,   /*VP8_VL*/
          <0x16028400 0x400>;   /*VP9_VD*/
      interrupts = <GIC_SPI 204 IRQ_TYPE_LEVEL_LOW>;
      iommus = <&iommu M4U_PORT_HW_VDEC_MC_EXT>,
             <&iommu M4U_PORT_HW_VDEC_PP_EXT>,
             <&iommu M4U_PORT_HW_VDEC_AVC_MV_EXT>,
             <&iommu M4U_PORT_HW_VDEC_PRED_RD_EXT>,
             <&iommu M4U_PORT_HW_VDEC_PRED_WR_EXT>,
             <&iommu M4U_PORT_HW_VDEC_UFO_EXT>,
             <&iommu M4U_PORT_HW_VDEC_VLD_EXT>,
             <&iommu M4U_PORT_HW_VDEC_VLD2_EXT>;
      mediatek,vpu = <&vpu>;
      mediatek,vdecsys = <&vdecsys>;
      power-domains = <&scpsys MT8173_POWER_DOMAIN_VDEC>;
      clocks = <&apmixedsys CLK_APMIXED_VCODECPLL>,
             <&topckgen CLK_TOP_UNIVPLL_D2>,
             <&topckgen CLK_TOP_CCI400_SEL>,
             <&topckgen CLK_TOP_VDEC_SEL>,
             <&topckgen CLK_TOP_VCODECPLL>,
             <&apmixedsys CLK_APMIXED_VENCPLL>,
             <&topckgen CLK_TOP_VENC_LT_SEL>,
             <&topckgen CLK_TOP_VCODECPLL_370P5>;
      clock-names = "vcodecpll",
                  "univpll_d2",
                  "clk_cci400_sel",
                  "vdec_sel",
                  "vdecpll",
                  "vencpll",
                  "venc_lt_sel",
                  "vdec_bus_clk_src";
      assigned-clocks = <&topckgen CLK_TOP_VENC_LT_SEL>,
                      <&topckgen CLK_TOP_CCI400_SEL>,
                      <&topckgen CLK_TOP_VDEC_SEL>,
                      <&apmixedsys CLK_APMIXED_VCODECPLL>,
                      <&apmixedsys CLK_APMIXED_VENCPLL>;
      assigned-clock-parents = <&topckgen CLK_TOP_VCODECPLL_370P5>,
                             <&topckgen CLK_TOP_UNIVPLL_D2>,
                             <&topckgen CLK_TOP_VCODECPLL>;
      assigned-clock-rates = <0>, <0>, <0>, <1482000000>, <800000000>;
    };
  - |
    #include <dt-bindings/clock/mediatek,mt6768-clock.h>
    #include <dt-bindings/interrupt-controller/arm-gic.h>
    #include <dt-bindings/interrupt-controller/irq.h>
    #include <dt-bindings/memory/mediatek,mt6768-memory-port.h>
    #include <dt-bindings/power/mediatek,mt6768-power-controller.h>

    vcodec_dec: video-codec@16020000 {
      compatible = "mediatek,mt6768-vcodec-dec";
      reg = <0 0x16025000 0 0x1000>, /* VDEC_MISC */
            <0 0x16020000 0 0x400>,  /* VDEC_VLD */
            <0 0x16020800 0 0x800>,  /* VDEC_VLD_TOP */
            <0 0x16021000 0 0x1000>, /* VDEC_MC */
            <0 0x16023000 0 0x1000>, /* VDEC_AVC_MV */
            <0 0x16022000 0 0x1000>, /* VDEC_AVC_VLD */
            <0 0x16024000 0 0x1000>; /* VDEC_PP */
      reg-names = "misc", "ld", "top", "cm", "ad", "av", "pp";
      interrupts = <GIC_SPI 246 IRQ_TYPE_LEVEL_LOW>;
      iommus = <&iommu M4U_PORT_HW_VDEC_MC_EXT>,
               <&iommu M4U_PORT_HW_VDEC_PP_EXT>,
               <&iommu M4U_PORT_HW_VDEC_VLD_EXT>,
               <&iommu M4U_PORT_HW_VDEC_VLD2_EXT>,
               <&iommu M4U_PORT_HW_VDEC_AVC_MV_EXT>,
               <&iommu M4U_PORT_HW_VDEC_PRED_RD_EXT>,
               <&iommu M4U_PORT_HW_VDEC_PRED_WR_EXT>,
               <&iommu M4U_PORT_HW_VDEC_PPWRAP_EXT>,
               <&iommu M4U_PORT_HW_VDEC_TILE_EXT>;
      mediatek,vdecsys = <&vdecsys>;
      power-domains = <&spm MT6768_POWER_DOMAIN_VDEC>;
      clocks = <&vdecsys CLK_VDEC_VDEC>;
      clock-names = "vdec";
    };
```

## Documentation/devicetree/bindings/power/supply/sgmicro,sgm41542.yaml
```yaml
# SPDX-License-Identifier: (GPL-2.0-only OR BSD-2-Clause)
%YAML 1.2
---
$id: http://devicetree.org/schemas/power/supply/sgmicro,sgm41542.yaml#
$schema: http://devicetree.org/meta-schemas/core.yaml#

title: SGM41542/SC8960x Battery Charger

description: |
  The SGMicro SGM41542 and the register-compatible Southchip SC8960x are
  single cell battery chargers/boost controllers.

maintainers:
  - Chris Morgan <macromorgan@hotmail.com>
  - Xu Shengfei <xsf@rock-chips.com>

allOf:
  - $ref: power-supply.yaml#

properties:
  compatible:
    enum:
      - sgmicro,sgm41542
      - sc,sc89601d

  input-current-limit-microamp:
    default: 2400000
    minimum: 100000
    maximum: 3800000

  input-voltage-limit-microvolt:
    default: 4500000
    minimum: 3900000
    maximum: 12000000

  interrupts:
    maxItems: 1

  monitored-battery:
    description: |
        The charger uses the following battery properties
        constant-charge-current-max-microamp (default 2040000)
        constant-charge-voltage-max-microvolt (default 4208000)
        charge-term-current-microamp (default 180000)
        precharge-current-microamp (default 180000)

  reg:
    maxItems: 1

  regulators:
    type: object
    properties:
      otg-vbus:
        type: object
        description: OTG boost regulator
        $ref: /schemas/regulator/regulator.yaml
        unevaluatedProperties: false
    additionalProperties: false

required:
  - compatible
  - reg

unevaluatedProperties: false

examples:
  - |
    #include <dt-bindings/gpio/gpio.h>
    #include <dt-bindings/interrupt-controller/irq.h>

    battery: battery {
      compatible = "simple-battery";
      constant-charge-current-max-microamp = <10000000>;
      constant-charge-voltage-max-microvolt = <4350000>;
      precharge-current-microamp = <180000>;
      charge-term-current-microamp = <300000>;
    };

    i2c {
      #address-cells = <1>;
      #size-cells = <0>;

      charger@3b {
        compatible = "sgmicro,sgm41542";
        reg = <0x3b>;
        input-current-limit-microamp = <3000000>;
        input-voltage-limit-microvolt = <4500000>;
        interrupt-parent = <&gpio0>;
        interrupts = <26 IRQ_TYPE_EDGE_FALLING>;
        monitored-battery = <&battery>;

        regulators {
          otg-vbus {
            regulator-max-microvolt = <5000000>;
            regulator-min-microvolt = <5000000>;
          };
        };
      };
    };
```

## Documentation/devicetree/bindings/sound/foursemi,fs15xx.yaml
```yaml
# SPDX-License-Identifier: (GPL-2.0-only OR BSD-2-Clause)
%YAML 1.2
---
$id: http://devicetree.org/schemas/sound/foursemi,fs15xx.yaml#
$schema: http://devicetree.org/meta-schemas/core.yaml#

title: FourSemi FS15xx GPIO pulse controlled speaker amplifier

maintainers:
  - Roman Vivchar <rva333@protonmail.com>

description: |
  FS15xx and SPC1910 amplifiers select their operating mode with timed pulses
  on a command GPIO. They have no audio data interface. The optional mod GPIO
  is low while boost is enabled. The optional id GPIO can be sampled for board
  identification.

properties:
  compatible:
    const: foursemi,fs15xx

  fsm,dev-type:
    description: Zero selects the SPC1910 protocol; one selects FS15xx.
    enum: [0, 1]

  fsm,id-gpio:
    description: Optional identification input, driven high briefly for sampling.
    maxItems: 1

  fsm,cmd-gpio:
    description: Command line. Its GPIO controller must support atomic access.
    maxItems: 1

  fsm,mod-gpio:
    description: Optional boost control, active at a low physical level.
    maxItems: 1

  pinctrl-names:
    items:
      - const: fs15xx_id_default
      - const: fs15xx_cmd_default
      - const: fs15xx_mod_default

  pinctrl-0: true
  pinctrl-1: true
  pinctrl-2: true

required:
  - compatible
  - fsm,dev-type
  - fsm,cmd-gpio

additionalProperties: false

examples:
  - |
    #include <dt-bindings/gpio/gpio.h>
    amplifier {
        compatible = "foursemi,fs15xx";
        fsm,dev-type = <1>;
        fsm,cmd-gpio = <&pio 179 GPIO_ACTIVE_HIGH>;
    };
```
